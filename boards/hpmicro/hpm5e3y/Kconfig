## boards/hpmicro/hpm5e3y/Kconfig
```kconfig
# Copyright (c) 2026 HPMicro
# SPDX-License-Identifier: Apache-2.0

if BOARD_HPM5E3Y

config INIT_EXT_RAM
	bool "Initialize external RAM(SDRAM or DDR)"
	default n

endif
```

## boards/hpmicro/hpm5e3y/Kconfig.hpm5e3y
```kconfig
# Copyright (c) 2026 HPMicro
# SPDX-License-Identifier: Apache-2.0

config BOARD_HPM5E3Y
	select SOC_HPM5E3Y
	select ZEPHYR_HPM_SDK_MODULE
```

## boards/hpmicro/hpm5e3y/board.yml
```yaml
board:
  name: hpm5e3y
  full_name: HPMicro HPM5E3Y
  vendor: hpmicro
  socs:
    - name: hpm5e3y
```

## boards/hpmicro/hpm5e3y/hpm5e3y_defconfig
```kconfig
CONFIG_XIP=y
CONFIG_CONSOLE=y
CONFIG_UART_CONSOLE=y
CONFIG_PINCTRL=y
CONFIG_GPIO=y
CONFIG_SERIAL=y
CONFIG_FLASH=y
CONFIG_DCACHE=n
CONFIG_SOC_ANDES_V5_PMA=n
CONFIG_HPM5E_DOUBLE_PRECISION_FPU=y

CONFIG_ROM_START_OFFSET=0x3100
```
